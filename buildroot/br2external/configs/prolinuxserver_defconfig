## buildroot/br2external/configs/prolinuxserver_defconfig
```kconfig
BR2_x86_64=y
BR2_OPTIMIZE_2=y
BR2_SSP_REGULAR=y
BR2_RELRO_FULL=y
BR2_FORTIFY_SOURCE_1=y
BR2_TOOLCHAIN_BUILDROOT_GLIBC=y
BR2_TOOLCHAIN_BUILDROOT_CXX=y
BR2_TARGET_GENERIC_HOSTNAME="sineware-live"
BR2_TARGET_GENERIC_ISSUE="Welcome to Sineware ProLinux Server"
BR2_ROOTFS_DEVICE_CREATION_DYNAMIC_MDEV=y
BR2_ROOTFS_MERGED_USR=y
BR2_TARGET_GENERIC_ROOT_PASSWD="1234"
BR2_SYSTEM_DHCP="eth0"
BR2_SYSTEM_DEFAULT_PATH="/bin:/sbin:/usr/bin:/usr/sbin"
BR2_PACKAGE_BUSYBOX_SHOW_OTHERS=y
BR2_PACKAGE_NILFS_UTILS=y
BR2_PACKAGE_ASCII_INVADERS=y
BR2_PACKAGE_PYTHON3=y
BR2_PACKAGE_BASH_COMPLETION=y
BR2_PACKAGE_NEOFETCH=y
BR2_PACKAGE_HTOP=y
BR2_PACKAGE_NANO=y
BR2_PACKAGE_HOST_KMOD=y
```
